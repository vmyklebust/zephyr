## boards/ti/lp_em_cc2745r10_q1/lp_em_cc2745r10_q1_defconfig
```kconfig
# Copyright (c) 2025 Texas Instruments Incorporated
# Copyright (c) 2024 BayLibre, SAS
#
# SPDX-License-Identifier: Apache-2.0

CONFIG_GPIO=y
```

## drivers/dma/Kconfig.lpf3
```kconfig
# TI LPF3 DMA configuration options

# Copyright (c) 2025 Texas Instruments Incorporated
# Copyright (c) 2024 BayLibre, SAS
# SPDX-License-Identifier: Apache-2.0

config DMA_LPF3
	bool "TI LPF3 DMA driver"
	default y
	depends on DT_HAS_TI_LPF3_DMA_ENABLED
	help
	  DMA driver for TI LPF3 MCU family (CC23X0, CC27XX).
```

## drivers/timer/Kconfig.lpf3
```kconfig
# Copyright (c) 2026 Texas Instruments Incorporated
# Copyright (c) 2024 BayLibre, SAS
#
# SPDX-License-Identifier: Apache-2.0

choice
	prompt "TI SimpleLink CC23X default System Timer"
	depends on SOC_SERIES_CC23X0 || SOC_SERIES_CC27XX
	default LPF3_SYSTIM_TIMER
	help
	  Select Default System Timer.

config LPF3_SYSTIM_TIMER
	bool "SYSTIM timer"
	select TICKLESS_CAPABLE
	help
	  This module provides SYSTIM as "system clock driver" interfaces
	  for the TI Simplelink CC23X0 devices.

config CC23X0_RTC_TIMER
	bool "RTC timer"
	depends on SOC_SERIES_CC23X0
	select TICKLESS_CAPABLE
	help
	  This module provides RTC as "system clock driver" interfaces
	  for the TI Simplelink CC23X0 devices.
endchoice
```

## dts/bindings/dma/ti,lpf3-dma.yaml
```yaml
# Copyright (c) 2025 Texas Instruments Incorporated
# Copyright (c) 2024 BayLibre, SAS
# SPDX-License-Identifier: Apache-2.0

description: TI LPF3 DMA controller (CC23X0, CC27XX)

compatible: "ti,lpf3-dma"

include: dma-controller.yaml

properties:
  reg:
    required: true

  interrupts:
    required: true

  "#dma-cells":
    const: 2
    description: |
      The 1st cell specifies the DMA channel to be used for the data transfer.
      This channel should be unique between all peripherals that are using the
      DMA instance.
      The 2nd cell defines the peripheral trigger which is the source of the transfer.
      See the SoC's reference manual for all the supported request sources.

      Example of devicetree DMA channel configuration for the client part:

      &uart0 {
          dmas = <&dma 2 6>, <&dma 3 7>;
          dma-names = "tx", "rx";
      };

      Above, fragment 0 and 1 represent the different channels used to transfer
      data between peripheral and RAM. The numbers 6/7 are uart0 tx/rx triggers.

dma-cells:
  - channel
  - trigsrc
```
